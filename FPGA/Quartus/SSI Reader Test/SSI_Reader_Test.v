
//=======================================================
//  This code is generated by Terasic System Builder
//=======================================================

module SSI_Reader_Test(

	//////////// CLOCK //////////
	input 		          		CLOCK_50,

	//////////// LED //////////
	output		     [7:0]		LED,

	//////////// KEY //////////
	input 		     [1:0]		KEY,

	//////////// SW //////////
	input 		     [3:0]		SW,

	//////////// EEPROM //////////
	output		          		I2C_SCLK,
	inout 		          		I2C_SDAT,

	//////////// 2x13 GPIO Header //////////
	inout 		    [12:0]		GPIO_2,
	input 		     [2:0]		GPIO_2_IN,

	//////////// GPIO_0, GPIO_0 connect to GPIO Default //////////
	inout 		    [33:0]		GPIOH0,
	input 		     [1:0]		GPIOH0_IN,

	//////////// GPIO_1, GPIO_1 connect to GPIO Default //////////
	inout 		    [33:0]		GPIOH1,
	input 		     [1:0]		GPIOH1_IN
);



//=======================================================
//  REG/WIRE declarations
//=======================================================
	localparam RESOLUTION = 10;
	localparam CLOCK_FREQ = 50_000_000;
	
	//SSI Wires/Regs
	wire NCS, SSI_DataLine, SSI_CLK;
	wire [RESOLUTION-1:0] SSI_DataOut;
	reg NCS_prev;
	
	//UART Wires/Regs
	reg SSI_DataValid = 1'b0;

	reg [7:0] data_in_reg;
   wire [7:0] data_in, data_out;
   wire data_in_ready, data_out_valid, data_out_ready;
	wire rst, FPGA_SERIAL_RX, FPGA_SERIAL_TX;
	
	//I/O assignments:
	assign GPIOH0[0] = FPGA_SERIAL_TX; //writes to pin0
	assign FPGA_SERIAL_RX = GPIOH0[1]; //reads pin1
	
	assign GPIOH0[3] = NCS;
	assign GPIOH0[5] = SSI_CLK ;
	assign SSI_DataLine = GPIOH0[7];
	
	//UART assignments:
	assign data_in = SSI_DataOut[9:2];
	assign LED = {GPIOH0[9], GPIOH0[11], SSI_DataOut[9:4]};

//=======================================================
//  Structural coding
//=======================================================


	SSI_Reader #(
		.CLOCK_FREQ(CLOCK_FREQ),
		.SSI_CLK_PERIOD(0.000_001),
		.SSI_RES(RESOLUTION)
	) Read_SSI(
		.clk(CLOCK_50),
		.DataIn(SSI_DataLine),
		.magHIGH(),
		.magLOW(),
		.SSI_CLK(SSI_CLK),
		.NCS(NCS),
		.DataOut(SSI_DataOut),		
	);

	 uart # (
        .CLOCK_FREQ(CLOCK_FREQ),
        .BAUD_RATE(9600)
    ) on_chip_uart (
        .clk(CLOCK_50),
        .reset(rst),
        .data_in(data_in),
        .data_in_valid(SSI_DataValid),
        .data_in_ready(data_in_ready),
        .data_out(data_out),
        .data_out_valid(data_out_valid),
        .data_out_ready(data_out_ready),
        .serial_in(FPGA_SERIAL_RX),
        .serial_out(FPGA_SERIAL_TX)
    );
	 
	 always @(posedge CLOCK_50) begin
		if (NCS && (NCS != NCS_prev)) begin
			SSI_DataValid <= 1'b1;
			NCS_prev <= NCS;
		end
		else if (NCS) begin
			SSI_DataValid <= 1'b0;
		end
		else begin
			SSI_DataValid <= 1'b0;
			NCS_prev <= NCS;
		end
	 end
	 
endmodule